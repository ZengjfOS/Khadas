// VIM3
/dts-v1/;
/plugin/;

/ {
        compatible = "amlogic, g12b";

        fragment@0 {
                target = <&i2c3>;
                __overlay__ {
                        #address-cells = <1>;
                        #size-cells = <0>;
                        status = "okay";

                        DebugHAT@50 {
                                compatible = "atmel,24c02";
                                reg = <0x50>;
                                status = "okay";
                        };
                };
        };
};

